/*
 * Copyright (c) 2020 The ZMK Contributors
 * SPDX-License-Identifier: MIT
 */

/ {
    chosen {
        zmk,matrix-transform = &five_column_transform;
    };
};

&spi3 {
    ws2812@0 {
        chain-length = <24>;
    };
};
